## bringup/qc07f/audio-candidate/Kconfig
```kconfig
# SPDX-License-Identifier: GPL-2.0-only
config SND_QC07F_ADC2_CANDIDATE
	tristate "QC07F capture-only ADC2 source candidate (probe refuses)"
	depends on ARM && SND_PCM
	default n
	help
	  Offline source/ABI candidate only. No retail mic route, clock/reference,
	  cache, L2/IRQ retirement provider is qualified. Probe always refuses.
```

## bringup/qc07f/mmc-candidate/Kconfig
```kconfig
# SPDX-License-Identifier: GPL-2.0-only
config MMC_QC07F_CANDIDATE
	bool "QC07F MCI source-review candidate (probe refuses)"
	depends on MMC && OF && ARM
	default n
	help
	  Offline source/build candidate only. Probe unconditionally refuses
	  before claiming resources or starting card discovery. A measured,
	  reviewed routing/clock/shared-L2 retirement provider is still absent.
	  This is not SDHCI, SD support, or a qualified Linux block path.
```
